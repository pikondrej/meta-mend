## conf/layer.conf
```bitbake
# We have a conf and classes directory, add to BBPATH
BBPATH .= ":${LAYERDIR}"
# We have recipes-* directories, add to BBFILES
BBFILES += "${LAYERDIR}/recipes-*/*/*.bb"

BBFILE_COLLECTIONS += "mend"
BBFILE_PATTERN_mend = "^${LAYERDIR}/"
BBFILE_PRIORITY_mend = "99"

# This should only be incremented on significant changes that will
# cause compatibility issues with other layers
LAYERVERSION_mend = "1"
LAYERSERIES_COMPAT_mend = "kirkstone"
```
